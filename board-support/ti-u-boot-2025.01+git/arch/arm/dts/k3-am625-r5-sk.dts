// SPDX-License-Identifier: GPL-2.0
/*
 * AM625 SK dts file for R5 SPL
 * Copyright (C) 2021-2022 Texas Instruments Incorporated - https://www.ti.com/
 */

#include "k3-am625-sk.dts"
#include "k3-am62x-sk-ddr4-1600MTs.dtsi"
#include "k3-am62-ddr.dtsi"

#include "k3-am625-sk-u-boot.dtsi"
#include "k3-am62-r5-sk-common.dtsi"

&main_pktdma {
	ti,sci = <&dm_tifs>;
	bootph-all;
};

/* ===== CRZ ADDED START: NAND/GPMC support for R5 SPL ===== */
#ifdef CONFIG_NAND_OMAP_GPMC

&elm0 {
	/delete-property/ power-domains;
};

&gpmc0 {
	/delete-property/ power-domains;
	clocks = <&dummy_133mhz_clk>;
};

#endif
/* ===== CRZ ADDED END ===== */
